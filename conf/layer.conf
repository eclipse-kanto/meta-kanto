## conf/layer.conf
```bitbake
# We have a conf and classes directory, add to BBPATH
BBPATH .= ":${LAYERDIR}"

# We have recipes-* directories, add to BBFILES
BBFILES += "${LAYERDIR}/recipes-*/*/*.bb \
            ${LAYERDIR}/recipes-*/*/*.bbappend"

BBFILE_COLLECTIONS += "meta-kanto"
BBFILE_PATTERN_meta-kanto = "^${LAYERDIR}/"
BBFILE_PRIORITY_meta-kanto = "6"

LAYERDEPENDS_meta-kanto = " \
           core \
           networking-layer \
           virtualization-layer \
"

LAYERSERIES_COMPAT_meta-kanto = "langdale mickledore nanbield"
 
```
